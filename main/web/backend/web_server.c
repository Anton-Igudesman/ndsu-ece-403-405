#include "web_server.h"
#include "client_manager.h"
#include "web_terminal.h"
#include "terminal_session_manager.h"

#include <stdbool.h>
#include <string.h>
#include <stdio.h>
#include <limits.h>

#include "esp_http_server.h"
#include "esp_netif_ip_addr.h"
#include "esp_netif.h"
#include "esp_log.h"
#include "esp_wifi.h"
#include "cJSON.h"
#include "lwip/sockets.h"
#include "lwip/inet.h"

// -----------------------------------------------------------
// ---------------- Server Configuration ---------------------
// -----------------------------------------------------------

#define WEB_ADMIN_USERNAME "admin"
#define WEB_ADMIN_PASSWORD "admin"
#define WEB_MAX_CLIENTS 8U

// -----------------------------------------------------------
// ---------------- Module Scope Definitions -----------------
// -----------------------------------------------------------

static const char *LOG_TAG = "web_server";

static httpd_handle_t s_server = NULL;
static bool s_initialized = false;

typedef struct
{
   int socket_fd;
   uint8_t mac[6];
} admin_websocket_t;

typedef struct
{
   const char *name;
   const char *event;
   esp_err_t (*handler)(httpd_req_t *request, const cJSON *root);
   bool affects_ownership;
   bool affects_pending_requests;
} terminal_action_entry_t;

// Track WebSocket connections for all currently connected administrators
static admin_websocket_t s_admin_websockets[WEB_MAX_CLIENTS];

// Embedded Svelte frontend files generated by the Vite production build
extern const uint8_t index_html_start[]
   asm("_binary_index_html_start");

extern const uint8_t index_html_end[]
   asm("_binary_index_html_end");

extern const uint8_t app_js_start[]
   asm("_binary_app_js_start");

extern const uint8_t app_js_end[]
   asm("_binary_app_js_end");

extern const uint8_t app_css_start[]
   asm("_binary_app_css_start");

extern const uint8_t app_css_end[]
   asm("_binary_app_css_end");

// ------- Forward declarations ---------
static esp_err_t get_request_client_mac(
   httpd_req_t *request,
   uint8_t mac[6]
);

static esp_err_t send_websocket_json(
   int socket_fd,
   const cJSON *response
);

static esp_err_t notify_terminal_ownership_changed(void);
static void broadcast_terminal_ownership_changed(void);
static void broadcast_terminal_pending_requests(void);

// Notify the owning device of the current pending control requests
static esp_err_t notify_terminal_pending_requests(void);

// -----------------------------------------------------------
// ---------------- Private Function Definitions -------------
// -----------------------------------------------------------

// Resolve a connected device's IPv4 address from its MAC
static esp_err_t get_client_ip_by_mac(
   const uint8_t mac[6],
   esp_ip4_addr_t *ip
)
{
   if (mac == NULL || ip == NULL) return ESP_ERR_INVALID_ARG;

   client_record_t clients[CLIENT_MANAGER_MAX_CLIENTS];
   size_t client_count = 0;

   esp_err_t status = client_manager_get_clients(
      clients,
      CLIENT_MANAGER_MAX_CLIENTS,
      &client_count
   );

   if (status != ESP_OK) return status;

   for (size_t i = 0; i < client_count; i++)
   {
      if (memcmp(clients[i].mac, mac, sizeof(clients[i].mac)) != 0)
         continue;

      *ip = clients[i].ip;
      return ESP_OK;
   }

   return ESP_ERR_NOT_FOUND;
}

// Resolve the current terminal owner's IPv4 address
static esp_err_t get_terminal_owner_ip(esp_ip4_addr_t *ip)
{
   if (ip == NULL) return ESP_ERR_INVALID_ARG;

   int owner_fd = terminal_session_manager_get_owner();
   if (owner_fd < 0) return ESP_ERR_NOT_FOUND;

   uint8_t owner_mac[6];

   esp_err_t status = terminal_session_manager_get_client_mac(
      owner_fd,
      owner_mac
   );

   if (status != ESP_OK) return status;

   return get_client_ip_by_mac(owner_mac, ip);
}

// Add device and owner IP addresses, using null when unavailable
static esp_err_t add_terminal_ip_fields(
   cJSON *response,
   int socket_fd
)
{
   if (response == NULL) return ESP_ERR_INVALID_ARG;

   uint8_t client_mac[6];
   esp_ip4_addr_t client_ip;
   esp_ip4_addr_t owner_ip;

   char client_ip_string[16];
   char owner_ip_string[16];

   const char *client_ip_value = NULL;
   const char *owner_ip_value = NULL;

   // Resolve the receiving device's IP without blocking ownership updates
   esp_err_t status = terminal_session_manager_get_client_mac(
      socket_fd,
      client_mac
   );

   if (status == ESP_OK)
   {
      status = get_client_ip_by_mac(client_mac, &client_ip);

      if (status == ESP_OK)
      {
         snprintf(
            client_ip_string,
            sizeof(client_ip_string),
            IPSTR,
            IP2STR(&client_ip)
         );

         client_ip_value = client_ip_string;
      }
   }

   // Resolve the current owner's IP when an owner exists
   status = get_terminal_owner_ip(&owner_ip);

   if (status == ESP_OK)
   {
      snprintf(
         owner_ip_string,
         sizeof(owner_ip_string),
         IPSTR,
         IP2STR(&owner_ip)
      );

      owner_ip_value = owner_ip_string;
   }

   // Always include both fields, even when an address is unavailable
   cJSON *client_field = client_ip_value != NULL
      ? cJSON_AddStringToObject(response, "client_ip", client_ip_value)
      : cJSON_AddNullToObject(response, "client_ip");

   if (client_field == NULL) return ESP_ERR_NO_MEM;

   cJSON *owner_field = owner_ip_value != NULL
      ? cJSON_AddStringToObject(response, "owner_ip", owner_ip_value)
      : cJSON_AddNullToObject(response, "owner_ip");

   if (owner_field == NULL) return ESP_ERR_NO_MEM;

   return ESP_OK;
}

// Broadcast pending-request updates without affecting the original operation
static void broadcast_terminal_pending_requests(void)
{
   esp_err_t status = notify_terminal_pending_requests();

   if (status != ESP_OK)
   {
      ESP_LOGW(
         LOG_TAG,
         "Terminal pending-request notification failed: %s",
         esp_err_to_name(status)
      );
   }
}

// Create a notification containing the current pending control requests
static cJSON *create_pending_requests_notification(cJSON *requests)
{
   if (requests == NULL) return NULL;

   cJSON *response = cJSON_CreateObject();
   if (response == NULL) return NULL;

   if (cJSON_AddStringToObject(response, "event", "terminal_pending_requests") == NULL)
   {
      cJSON_Delete(response);
      return NULL;
   }

   // Transfer ownership of the requests array to the notification
   if (!cJSON_AddItemToObject(response, "requests", requests))
   {
      cJSON_Delete(response);
      return NULL;
   }

   return response;
}

// Send a pending-request notification to all connections on the owning device
static esp_err_t send_pending_requests_to_owner(const cJSON *response)
{
   if (response == NULL) return ESP_ERR_INVALID_ARG;

   int socket_fds[TERMINAL_MAX_CLIENTS];

   size_t client_count = terminal_session_manager_get_clients(
      socket_fds,
      TERMINAL_MAX_CLIENTS
   );

   esp_err_t final_status = ESP_OK;

   for (size_t i = 0; i < client_count; i++)
   {
      if (!terminal_session_manager_is_owner(socket_fds[i])) continue;

      esp_err_t status = send_websocket_json(socket_fds[i], response);
      if (status != ESP_OK) final_status = status;
   }

   return final_status;
}

// Create a JSON array containing pending terminal control requests
static cJSON *create_pending_requests_json(
   const int *requester_fds,
   size_t request_count
)
{
   if (requester_fds == NULL && request_count > 0U) return NULL;

   cJSON *requests = cJSON_CreateArray();
   if (requests == NULL) return NULL;

   for (size_t i = 0; i < request_count; i++)
   {
      cJSON *request = cJSON_CreateObject();

      if (request == NULL)
      {
         cJSON_Delete(requests);
         return NULL;
      }

      if (cJSON_AddNumberToObject(request, "requester_fd", requester_fds[i]) == NULL)
      {
         cJSON_Delete(request);
         cJSON_Delete(requests);
         return NULL;
      }
      cJSON_AddItemToArray(requests, request);
   }

   return requests;
}

// Notify the owning device of pending terminal control requests
static esp_err_t notify_terminal_pending_requests(void)
{
   int requester_fds[TERMINAL_MAX_CLIENTS];

   size_t request_count = terminal_session_manager_get_pending_requests(
      requester_fds,
      TERMINAL_MAX_CLIENTS
   );

   cJSON *requests = create_pending_requests_json(
      requester_fds,
      request_count
   );

   if (requests == NULL) return ESP_ERR_NO_MEM;

   // Build the notification from pending requests
   cJSON *response = create_pending_requests_notification(requests);

   if (response == NULL)
   {
      cJSON_Delete(requests);
      return ESP_ERR_NO_MEM;
   }

   // Deliver the notificatoin and release its JSON data
   esp_err_t status = send_pending_requests_to_owner(response);
   cJSON_Delete(response);

   return status;
}

// Execute a terminal action and notify clients of ownershp and request updates
static esp_err_t execute_terminal_action(
   const terminal_action_entry_t *entry,
   httpd_req_t *request,
   const cJSON *root
)
{
   if (entry == NULL) return ESP_ERR_INVALID_ARG;

   esp_err_t status = entry->handler(request, root);
   if(status != ESP_OK) return status;

   // Send the updated request list to the current owning device
   if (entry->affects_pending_requests) broadcast_terminal_pending_requests();

   // Notify all devices after ownership or pending-request changes
   if (entry->affects_ownership || entry->affects_pending_requests) broadcast_terminal_ownership_changed();

   return status;
}

// Return the current LED operating mode
static esp_err_t handle_terminal_get_mode(
   httpd_req_t *request,
   const cJSON *root
)
{
   (void)request;

   return web_terminal_execute(root);
}

// Broadcast ownership changes without affecting original operation
static void broadcast_terminal_ownership_changed(void)
{
   esp_err_t status = notify_terminal_ownership_changed();

   // A notification failure must not invalidate an ownership change
   if (status != ESP_OK)
   {
      ESP_LOGW(
         LOG_TAG,
         "Terminal ownership notification failed: %s",
         esp_err_to_name(status)
      );
   }
}

// Request terminal ownership for the connected client
static esp_err_t handle_terminal_request_control(
   httpd_req_t *request,
   const cJSON *root
)
{
   (void)root;

   return terminal_session_manager_request_control(httpd_req_to_sockfd(request));
}

// Release ownership of the terminal
static esp_err_t handle_terminal_release_control(
   httpd_req_t *request,
   const cJSON *root
)
{
   (void)root;

   return terminal_session_manager_release_control(httpd_req_to_sockfd(request));
}

// Extract and validate a terminal control requester's socket descriptor
static esp_err_t get_terminal_requester_fd(
   const cJSON *root,
   int *requester_fd
)
{
   if (root == NULL || requester_fd == NULL) return ESP_ERR_INVALID_ARG;

   const cJSON *requester = cJSON_GetObjectItemCaseSensitive(
      root,
      "requester_fd"
   );

   if (!cJSON_IsNumber(requester)) return ESP_ERR_INVALID_ARG;

   double value = requester->valuedouble;

   // Reject negative, fractional, and out-of-range descriptors
   if (value < 0.0 || value > INT_MAX || value != (double)(int)value) return ESP_ERR_INVALID_ARG;

   *requester_fd = (int)value;

   return ESP_OK;
}

// Grant terminal control to a requesting client
static esp_err_t handle_terminal_grant_control(
   httpd_req_t *request,
   const cJSON *root
)
{
   int requester_fd;

   esp_err_t status = get_terminal_requester_fd(root, &requester_fd);
   if (status != ESP_OK) return status;

   return terminal_session_manager_grant_control(
      httpd_req_to_sockfd(request),
      requester_fd
   );
}

// Deny a pending terminal control request
static esp_err_t handle_terminal_deny_control(
   httpd_req_t *request,
   const cJSON *root
)
{
   int requester_fd;
   esp_err_t status = get_terminal_requester_fd(root, &requester_fd);
   if (status != ESP_OK) return status;

   return terminal_session_manager_deny_control(
      httpd_req_to_sockfd(request),
      requester_fd
   );
}

// Allow an authenticated administrator to take terminal control immediately
static esp_err_t handle_terminal_admin_takeover(
   httpd_req_t *request,
   const cJSON *root
)
{
   (void)sizeof(root);
   uint8_t client_mac[6];

   esp_err_t status = get_request_client_mac(request, client_mac);
   if (status != ESP_OK) return status;
   
   if (!client_manager_is_admin(client_mac)) return ESP_ERR_INVALID_STATE;

   return terminal_session_manager_admin_takeover(httpd_req_to_sockfd(request));
}

// Change the LED operating mode for the current terminal owner
static esp_err_t handle_terminal_set_mode(
   httpd_req_t *request,
   const cJSON *root
)
{
   int socket_fd = httpd_req_to_sockfd(request);

   // Log incoming mode activation requests and ownership status
   bool is_owner = terminal_session_manager_is_owner(socket_fd);

   ESP_LOGI(
      LOG_TAG,
      "Command Mode request: socket=%d owner=%d",
      socket_fd,
      is_owner
   );

   if (!is_owner)
   {
      ESP_LOGW(
         LOG_TAG,
         "Command Mode rejected: socket=%d is not terminal owner",
         socket_fd
      );

      return ESP_ERR_INVALID_STATE;
   }

   // Execute the mode change and report the result
   esp_err_t status = web_terminal_execute(root);

   ESP_LOGI(
      LOG_TAG,
      "Command Mode result: socket=%d status=%s",
      socket_fd,
      esp_err_to_name(status)
   );

   return status;
}

// Return the requesting terminal client's current ownership status
static esp_err_t handle_terminal_get_ownership(
   httpd_req_t *request,
   const cJSON *root
)
{
   (void)root;
   int socket_fd = httpd_req_to_sockfd(request);

   cJSON *response = cJSON_CreateObject();
   if (response == NULL) return ESP_ERR_NO_MEM;

   // Report ownership relative to requesting connection
   cJSON_AddStringToObject(response, "event", "terminal_ownership_changed");
   cJSON_AddBoolToObject(response, "is_owner", terminal_session_manager_is_owner(socket_fd));
   cJSON_AddBoolToObject(response, "owner_present", terminal_session_manager_get_owner() >= 0);

   // Report whether the requesting device has a pending control request
   cJSON_AddBoolToObject(
      response,
      "request_pending",
      terminal_session_manager_has_pending_request(socket_fd)
   );

   // Include device identification in the initial ownership response
   esp_err_t ip_status = add_terminal_ip_fields(
      response,
      socket_fd
   );

   if (ip_status != ESP_OK)
   {
      ESP_LOGW(
         LOG_TAG,
         "Unable to resolve terminal IP addresses: %s",
         esp_err_to_name(ip_status)
      );
   }

   esp_err_t status = send_websocket_json(
      socket_fd,
      response
   );

   cJSON_Delete(response);

   return status;
}

// Map terminal actions to their response events and handlers
static const terminal_action_entry_t s_terminal_actions[] = 
{
   {"get_mode", "mode_status", handle_terminal_get_mode, false, false},
   {"set_mode", "mode_activation_result", handle_terminal_set_mode, false, false},
   {"request_control", "control_request_result", handle_terminal_request_control, true, true},
   {"release_control", "control_release_result", handle_terminal_release_control, true, true},
   {"grant_control", "control_grant_result", handle_terminal_grant_control, true, true},
   {"deny_control", "control_deny_result", handle_terminal_deny_control, false, true},
   {"admin_takeover", "control_takeover_result", handle_terminal_admin_takeover, true, true},
   {"get_ownership", "terminal_ownership_status_result", handle_terminal_get_ownership, false, false},
};

// Resolve and execute a terminal action using the registered handlers
static esp_err_t dispatch_terminal_action(
   httpd_req_t *request,
   const cJSON *root,
   const char **event
)
{
   int socket_fd = httpd_req_to_sockfd(request);
   const cJSON *action = cJSON_GetObjectItemCaseSensitive(root, "action");

   *event = "terminal_result";

   if (!cJSON_IsString(action))
   {
      // Pixel commands require terminal ownership
      if (!terminal_session_manager_is_owner(socket_fd)) return ESP_ERR_INVALID_STATE;
      return web_terminal_execute(root);
   }

   const size_t action_count = sizeof(s_terminal_actions) / sizeof(s_terminal_actions[0]);
   for (size_t i = 0; i < action_count; i++)
   {
      const terminal_action_entry_t *entry = &s_terminal_actions[i];

      if (strcmp(action->valuestring, entry->name) != 0) continue;

      *event = entry->event;
      
      // Execute the matched action and handle ownership notifications
      return execute_terminal_action(entry, request, root);   
   }

   return ESP_ERR_NOT_SUPPORTED;
}

// Parse a MAC address string into six bytes
static esp_err_t parse_mac_address(
   const char *mac_string,
   uint8_t mac[6]
)
{
   if (mac_string == NULL || mac == NULL)
      return ESP_ERR_INVALID_ARG;

   unsigned int bytes[6];
   int consumed = 0;

   // Parse six hexadecimal bytes and record the number of characters consumed
   int parsed = sscanf(
      mac_string,
      "%2x:%2x:%2x:%2x:%2x:%2x%n",
      &bytes[0],
      &bytes[1],
      &bytes[2],
      &bytes[3],
      &bytes[4],
      &bytes[5],
      &consumed
   );

   // Require all six bytes, exactly 17 characters, and no trailing data
   if (parsed != 6 || consumed != 17 ||
       mac_string[consumed] != '\0')
      return ESP_ERR_INVALID_ARG;

   // Convert the parsed hexadecimal values into individual bytes
   for (size_t index = 0; index < 6; index++)
      mac[index] = (uint8_t)bytes[index];

   return ESP_OK;
}

// Process an administrator controller authorization action
static esp_err_t process_admin_controller_action(const cJSON *root)
{
   if (root == NULL) return ESP_ERR_INVALID_ARG;

   // Extract the requested action and target MAC address from the JSON message
   const cJSON *action = cJSON_GetObjectItemCaseSensitive(
      root,
      "action"
   );

   const cJSON *mac_string = cJSON_GetObjectItemCaseSensitive(
      root,
      "mac"
   );

   // Both JSON fields must contain strings
   if (!cJSON_IsString(action) || !cJSON_IsString(mac_string))
      return ESP_ERR_INVALID_ARG;

   uint8_t client_mac[6];

   // Convert the MAC address string into six bytes
   esp_err_t status = parse_mac_address(
      mac_string->valuestring,
      client_mac
   );

   if (status != ESP_OK) return status;

   // strcmp() returns 0 when both strings match.
   // Approve the pending client when the action is "approve_controller".
   if (strcmp(action->valuestring, "approve_controller") == 0)
      return client_manager_approve_controller(client_mac);

   // Deny the pending client when the action is "deny_controller".
   if (strcmp(action->valuestring, "deny_controller") == 0)
      return client_manager_deny_controller(client_mac);

   // Reject any action that the server does not recognize
   return ESP_ERR_NOT_SUPPORTED;
}

// Serialize and send a JSON object over an established WebSocket
static esp_err_t send_websocket_json(
   int socket_fd,
   const cJSON *response
)
{
   if (s_server == NULL || socket_fd < 0 || response == NULL) return ESP_ERR_INVALID_ARG;

   char *message = cJSON_PrintUnformatted(response);
   if (message == NULL) return ESP_ERR_NO_MEM;

   httpd_ws_frame_t frame = 
   {
      .final = true,
      .fragmented = false,
      .type = HTTPD_WS_TYPE_TEXT,
      .payload = (uint8_t *)message,
      .len = strlen(message)
   };

   esp_err_t status = httpd_ws_send_frame_async(
      s_server,
      socket_fd,
      &frame
   );

   cJSON_free(message);
   
   return status;
}

// Send a JSON result to the requesting WebSocket client
static esp_err_t send_websocket_response(
   int socket_fd,
   const char *event,
   esp_err_t action_status
)
{
   if (s_server == NULL || socket_fd < 0 || event == NULL) return ESP_ERR_INVALID_ARG;

   cJSON *response = cJSON_CreateObject();
   if (response == NULL) return ESP_ERR_NO_MEM;

   cJSON_AddStringToObject(response, "event", event);
   cJSON_AddBoolToObject(response, "success", action_status == ESP_OK);

   // Include the ESP-IDF error description when execution fails
   if (action_status != ESP_OK)
   {
      cJSON_AddStringToObject(
         response,
         "error",
         esp_err_to_name(action_status)
      );
   }

   esp_err_t status = send_websocket_json(
      socket_fd,
      response
   );

   cJSON_Delete(response);

   return status;
}

// Notify connected terminal when ownership changes
static esp_err_t notify_terminal_ownership_changed(void)
{
   int socket_fds[TERMINAL_MAX_CLIENTS];

   size_t client_count = terminal_session_manager_get_clients(
      socket_fds,
      TERMINAL_MAX_CLIENTS
   );

   esp_err_t final_status = ESP_OK;

   int owner_id = terminal_session_manager_get_owner();
   for (size_t i = 0; i < client_count; i++)
   {
      cJSON *response = cJSON_CreateObject();
      if (response == NULL) return ESP_ERR_NO_MEM;

      // Each client receives its own ownership status
      cJSON_AddStringToObject(response, "event", "terminal_ownership_changed");

      // Report each device's pending-request status alongside ownership changes
      cJSON_AddBoolToObject(
         response,
         "request_pending",
         terminal_session_manager_has_pending_request(socket_fds[i])
      );

      // All connections from a device must report the same ownership state
      bool is_owner = terminal_session_manager_is_owner(socket_fds[i]);

      cJSON_AddBoolToObject(response, "is_owner", is_owner);
      cJSON_AddBoolToObject(response, "owner_present", owner_id >= 0);

      // Include device identification in each ownership notification
      esp_err_t ip_status = add_terminal_ip_fields(
         response,
         socket_fds[i]
      );

      if (ip_status != ESP_OK)
      {
         ESP_LOGW(
            LOG_TAG,
            "Unable to resolve terminal IP addresses: %s",
            esp_err_to_name(ip_status)
         );
      }

      esp_err_t status = send_websocket_json(
         socket_fds[i],
         response
      );

      // Log ownership notification delivery for each terminal connection
      ESP_LOGI(
         LOG_TAG,
         "Ownership notification: socket=%d owner=%d present=%d status=%s",
         socket_fds[i],
         is_owner,
         owner_id >= 0,
         esp_err_to_name(status)
      );

      cJSON_Delete(response);

      if (status != ESP_OK) final_status = status;
   }

   return final_status;
}

// Send an authorization action result to the requesting administrator
static esp_err_t send_admin_websocket_response(
   int socket_fd,
   esp_err_t action_status
)
{
   return send_websocket_response(
      socket_fd,
      "controller_action_result",
      action_status
   );
}

/*
   Get the IPv4 address of the device that sent an HTTP request.

   The request socket identifies the remote TCP connection,
   allowing the server to determine which WiFi client sent it.
*/
static esp_err_t get_request_client_ip(
   httpd_req_t *request,
   esp_ip4_addr_t *client_ip
)
{
   if (request == NULL || client_ip == NULL)
      return ESP_ERR_INVALID_ARG;

   // Get the socket associated with this HTTP request.
   int socket_fd = httpd_req_to_sockfd(request);

   struct sockaddr_storage client_address = {0};
   socklen_t address_length = sizeof(client_address);

   // Read the remote device address from the TCP connection.
   if (getpeername(
         socket_fd,
         (struct sockaddr *)&client_address,
         &address_length) != 0) return ESP_FAIL;
   
      if (client_address.ss_family == AF_INET)
   {
      struct sockaddr_in *client_ipv4 =
         (struct sockaddr_in *)&client_address;

      client_ip->addr = client_ipv4->sin_addr.s_addr;

      return ESP_OK;
   }

   if (client_address.ss_family == AF_INET6)
   {
      struct sockaddr_in6 *client_ipv6 =
         (struct sockaddr_in6 *)&client_address;

      const uint8_t *address_bytes =
         client_ipv6->sin6_addr.s6_addr;

      /*
         IPv4-mapped IPv6 addresses use ::ffff:a.b.c.d.
         Extract the final four bytes so the address can be
         matched against the SoftAP DHCP client registry.
      */
      if (IN6_IS_ADDR_V4MAPPED(&client_ipv6->sin6_addr))
      {
         memcpy(
            &client_ip->addr,
            &address_bytes[12],
            sizeof(client_ip->addr)
         );

         return ESP_OK;
      }
   }

   ESP_LOGE(
      LOG_TAG,
      "Unable to resolve HTTP client to an IPv4 address"
   );

   return ESP_ERR_NOT_SUPPORTED;
}

// Get the MAC address of the client making an HTTP request
static esp_err_t get_request_client_mac(
   httpd_req_t *request,
   uint8_t mac[6]
)
{
   if (request == NULL || mac == NULL) return ESP_ERR_INVALID_ARG;

   esp_ip4_addr_t client_ip;

   esp_err_t status = get_request_client_ip(
      request,
      &client_ip
   );

   if (status != ESP_OK) return status;

   return client_manager_get_mac_by_ip(
      &client_ip,
      mac
   );
}

// Check whether an HTTP request belongs to an authenticated administrator
static bool is_admin_http_request(httpd_req_t *request)
{
   if (request == NULL) return false;

   uint8_t client_mac[6];

   esp_err_t status = get_request_client_mac(
      request,
      client_mac
   );

   if (status != ESP_OK) return false;

   return client_manager_is_admin(client_mac);
}

// Send an appropriate HTTP error for a controller request
static esp_err_t send_controller_request_error(
   httpd_req_t *request,
   esp_err_t status
)
{
   if (status == ESP_ERR_INVALID_STATE)
   {
      httpd_resp_set_status(request, "409 Conflict");

      return httpd_resp_send(
         request,
         "Controller request already pending or authorized",
         HTTPD_RESP_USE_STRLEN
      );
   }
      
   if (status == ESP_ERR_NOT_FOUND || status == ESP_ERR_NOT_SUPPORTED)
      return httpd_resp_send_err(request, HTTPD_403_FORBIDDEN, "Unable to identify client");

   ESP_LOGE(
      LOG_TAG,
      "Controller request failed: %s",
      esp_err_to_name(status)
   );

   return httpd_resp_send_err(
      request,
      HTTPD_500_INTERNAL_SERVER_ERROR,
      "Unable to process controller request"
   );
}

// Process a controller access request from a connected client
static esp_err_t process_controller_request(httpd_req_t *request)
{
   esp_err_t status = client_manager_sync_connected_clients();

   if (status != ESP_OK) return status;

   uint8_t client_mac[6];

   status = get_request_client_mac(
      request,
      client_mac
   );

   if (status != ESP_OK) return status;

   return client_manager_request_controller(client_mac);
}

// Handle controller access requests
static esp_err_t controller_request_post_handler(httpd_req_t *request)
{
   if (request == NULL) return ESP_ERR_INVALID_ARG;

   esp_err_t status = process_controller_request(request);

   if (status != ESP_OK)
      return send_controller_request_error(request, status);

   status = web_server_notify_clients_changed();

   if (status != ESP_OK)
   {
      ESP_LOGW(
         LOG_TAG,
         "Administrator notification failed: %s",
         esp_err_to_name(status)
      );
   }

   httpd_resp_set_type(request, "application/json");

   return httpd_resp_send(
      request,
      "{\"status\":\"pending\"}",
      HTTPD_RESP_USE_STRLEN
   );
}

// Return the requesting client's current authorization state
static esp_err_t controller_status_get_handler(httpd_req_t *request)
{
   if (request == NULL) return ESP_ERR_INVALID_ARG;

   uint8_t client_mac[6];

   esp_err_t status = client_manager_sync_connected_clients();

   if (status != ESP_OK)
      return httpd_resp_send_err(
         request,
         HTTPD_500_INTERNAL_SERVER_ERROR,
         "Unable to refresh connected clients"
      );

   status = get_request_client_mac(request, client_mac);

   if (status != ESP_OK)
      return httpd_resp_send_err(
         request,
         HTTPD_403_FORBIDDEN,
         "Unable to identify client"
      );

   client_auth_state_t auth_state;

   status = client_manager_get_auth_state(
      client_mac,
      &auth_state
   );

   if (status != ESP_OK)
      return httpd_resp_send_err(
         request,
         HTTPD_500_INTERNAL_SERVER_ERROR,
         "Unable to retrieve authorization state"
      );

   char response[32];

   snprintf(
      response,
      sizeof(response),
      "{\"auth_state\":%d}",
      (int)auth_state
   );

   httpd_resp_set_type(request, "application/json");

   return httpd_resp_send(
      request,
      response,
      HTTPD_RESP_USE_STRLEN
   );
}

/*
   Add an authenticated administrator WebSocket to the active registry.

   If the same device reconnects, its existing entry is updated rather
   than consuming another WebSocket slot.
*/
static esp_err_t register_admin_websocket(
   int socket_fd,
   const uint8_t mac[6]
)
{
   if (socket_fd < 0 || mac == NULL)
      return ESP_ERR_INVALID_ARG;

   // Update the existing entry if this administrator reconnects.
   for (size_t admin = 0; admin < WEB_MAX_CLIENTS; admin++)
   {
      if (memcmp(
            s_admin_websockets[admin].mac,
            mac,
            sizeof(s_admin_websockets[admin].mac)
         ) == 0)
      {
         s_admin_websockets[admin].socket_fd = socket_fd;
         return ESP_OK;
      }
   }

   // Otherwise use the first available WebSocket slot.
   for (size_t admin = 0; admin < WEB_MAX_CLIENTS; admin++)
   {
      if (s_admin_websockets[admin].socket_fd < 0)
      {
         s_admin_websockets[admin].socket_fd = socket_fd;

         memcpy(
            s_admin_websockets[admin].mac,
            mac,
            sizeof(s_admin_websockets[admin].mac)
         );

         return ESP_OK;
      }
   }

   return ESP_ERR_NO_MEM;
}

// Check whether a WebSocket belongs to an authenticated administrator
static bool is_admin_websocket(int socket_fd)
{
   for (size_t admin = 0; admin < WEB_MAX_CLIENTS; admin++)
   {
      if (s_admin_websockets[admin].socket_fd != socket_fd)
         continue;

      // Verify current authorization, not just WebSocket registration
      return client_manager_is_admin(
         s_admin_websockets[admin].mac
      );
   }

   return false;
}

// Check whether an administrator WebSocket is still connected
static bool is_admin_websocket_connected(int socket_fd)
{
   if (s_server == NULL || socket_fd < 0)
      return false;

   // Confirm the socket is still registered as an active WebSocket
   httpd_ws_client_info_t socket_info = httpd_ws_get_fd_info(
      s_server,
      socket_fd
   );

   return socket_info == HTTPD_WS_CLIENT_WEBSOCKET;
}

// Process an incoming administrator WebSocket text message
static esp_err_t process_admin_websocket_message(
   int socket_fd,
   const char *message
)
{
   if (message == NULL) return ESP_ERR_INVALID_ARG;

   // Reject messages from sockets without current administrator authorization
   if (!is_admin_websocket(socket_fd))
      return ESP_ERR_INVALID_STATE;

   // Convert the JSON text into an object containing the requested action
   cJSON *root = cJSON_Parse(message);

   if (root == NULL) return ESP_ERR_INVALID_ARG;

   esp_err_t status = process_admin_controller_action(root);

   // Release the parsed JSON object after processing the action
   cJSON_Delete(root);

   if (status != ESP_OK) return status;

   // Notify every connected administrator that client authorization changed
   status = web_server_notify_clients_changed();

   if (status != ESP_OK)
   {
      ESP_LOGW(
         LOG_TAG,
         "Administrator notification failed: %s",
         esp_err_to_name(status)
      );
   }

   return ESP_OK;
}

/*
   Remove an administrator WebSocket from the active registry.
*/
static void remove_admin_websocket(
   int socket_fd
)
{
   for (size_t admin = 0; admin < WEB_MAX_CLIENTS; admin++)
   {
      if (s_admin_websockets[admin].socket_fd == socket_fd)
      {
         s_admin_websockets[admin].socket_fd = -1;

         memset(
            s_admin_websockets[admin].mac,
            0,
            sizeof(s_admin_websockets[admin].mac)
         );

         return;
      }
   }
}

// Reset all administrator WebSocket slots to an unused state.
static void initialize_admin_websockets(void)
{
   for (size_t admin = 0; admin < WEB_MAX_CLIENTS; admin++)
   {
      s_admin_websockets[admin].socket_fd = -1;

      memset(
         s_admin_websockets[admin].mac,
         0,
         sizeof(s_admin_websockets[admin].mac)
      );
   }
}

/*
   Send one frontend file embedded in the firmware.

   The start and end linker symbols identify the file's location
   and size inside the firmware image.
*/
static esp_err_t send_embedded_file(
   httpd_req_t *request,
   const uint8_t *file_start,
   const uint8_t *file_end,
   const char *content_type
)
{
   if (request == NULL ||
      file_start == NULL ||
      file_end == NULL ||
      content_type == NULL ||
      file_end < file_start)
   {
      return ESP_ERR_INVALID_ARG;
   }

   httpd_resp_set_type(
      request,
      content_type
   );

   return httpd_resp_send(
      request,
      (const char *)file_start,
      file_end - file_start
   );
}

// Serve the Svelte application entry page
static esp_err_t frontend_index_get_handler(httpd_req_t *request)
{
   return send_embedded_file(
      request,
      index_html_start,
      index_html_end,
      "text/html"
   );
}

// Serve the compiled Svelte JavaScript bundle
static esp_err_t frontend_js_get_handler(httpd_req_t *request)
{
   return send_embedded_file(
      request,
      app_js_start,
      app_js_end,
      "application/javascript"
   );
}

// Serve the compiled Tailwind stylesheet
static esp_err_t frontend_css_get_handler(httpd_req_t *request)
{
   return send_embedded_file(
      request,
      app_css_start,
      app_css_end,
      "text/css"
   );
}

// Convert connected client MAC/IP information into dashboard JSON
static cJSON *create_clients_json(
   const client_record_t *clients,
   size_t client_count
)
{
   if (clients == NULL && client_count > 0)
      return NULL;

   cJSON *client_array = cJSON_CreateArray();
   if (client_array == NULL) return NULL;

   for (size_t client = 0; client < client_count; client++)
   {
      char mac_address[18];
      char ip_address[16];

      snprintf(
         mac_address,
         sizeof(mac_address),
         "%02X:%02X:%02X:%02X:%02X:%02X",
         clients[client].mac[0],
         clients[client].mac[1],
         clients[client].mac[2],
         clients[client].mac[3],
         clients[client].mac[4],
         clients[client].mac[5]
      );

      snprintf(
         ip_address,
         sizeof(ip_address),
         IPSTR,
         IP2STR(&clients[client].ip)
      );

      cJSON *client_json = cJSON_CreateObject();

      if (client_json == NULL)
      {
         cJSON_Delete(client_array);
         return NULL;
      }

      cJSON_AddStringToObject(
         client_json,
         "mac",
         mac_address
      );

      cJSON_AddStringToObject(
         client_json,
         "ip",
         ip_address
      );

      cJSON_AddNumberToObject(
         client_json,
         "auth_state",
         clients[client].auth_state
      );

      cJSON_AddItemToArray(
         client_array,
         client_json
      );
   }

   return client_array;
}

// Handle administrator login requests
static esp_err_t admin_login_post_handler(httpd_req_t *request)
{
   if (request == NULL) return ESP_ERR_INVALID_ARG;

   // Reject request bodies that cannot fit in the local buffer
   if (request->content_len <= 0 ||
      request->content_len >= 256)
   {
      httpd_resp_send_err(
         request,
         HTTPD_400_BAD_REQUEST,
         "Invalid request"
      );

      return ESP_OK;
   }

   char request_body[256];

   // Read the JSON request body
   int received = httpd_req_recv(
      request,
      request_body,
      request->content_len
   );

   if (received <= 0)
   {
      httpd_resp_send_err(
         request,
         HTTPD_400_BAD_REQUEST,
         "Unable to read request"
      );

      return ESP_OK;
   }

   request_body[received] = '\0';

   // Parse the submitted JSON credentials
   cJSON *root = cJSON_Parse(request_body);

   if (root == NULL)
   {
      httpd_resp_send_err(
         request,
         HTTPD_400_BAD_REQUEST,
         "Invalid JSON"
      );

      return ESP_OK;
   }

   const cJSON *username = cJSON_GetObjectItemCaseSensitive(
      root,
      "username"
   );

   const cJSON *password = cJSON_GetObjectItemCaseSensitive(
      root,
      "password"
   );

   bool credentials_valid =
      cJSON_IsString(username) &&
      cJSON_IsString(password) &&
      strcmp(username->valuestring, WEB_ADMIN_USERNAME) == 0 &&
      strcmp(password->valuestring, WEB_ADMIN_PASSWORD) == 0;

   cJSON_Delete(root);

   if (!credentials_valid)
   {
      httpd_resp_set_status(
         request,
         "401 Unauthorized"
      );

      return httpd_resp_send(
         request,
         "Unauthorized",
         HTTPD_RESP_USE_STRLEN
      );
   }

      // Refresh the registry so the login request can be matched to its WiFi client.
   esp_err_t status = client_manager_sync_connected_clients();

   if (status != ESP_OK)
   {
      ESP_LOGE(
         LOG_TAG,
         "Failed to refresh clients during administrator login: %s",
         esp_err_to_name(status)
      );

      return httpd_resp_send_err(
         request,
         HTTPD_500_INTERNAL_SERVER_ERROR,
         "Unable to identify client"
      );
   }

   esp_ip4_addr_t client_ip;

   // Get the source IP of the device that submitted the administrator login.
   status = get_request_client_ip(
      request,
      &client_ip
   );

   if (status != ESP_OK)
   {
      ESP_LOGE(
         LOG_TAG,
         "Failed to get administrator client IP"
      );

      return httpd_resp_send_err(
         request,
         HTTPD_500_INTERNAL_SERVER_ERROR,
         "Unable to identify client"
      );
   }

   // Associate administrator authorization with the matching WiFi client.
   status = client_manager_set_admin_by_ip(
      &client_ip
   );

   if (status != ESP_OK)
   {
      ESP_LOGE(
         LOG_TAG,
         "Failed to authorize administrator client: %s",
         esp_err_to_name(status)
      );

      return httpd_resp_send_err(
         request,
         HTTPD_500_INTERNAL_SERVER_ERROR,
         "Unable to authorize client"
      );
   }

   ESP_LOGI(
      LOG_TAG,
      "Administrator login successful"
   );

   httpd_resp_set_type(
      request,
      "application/json"
   );

   return httpd_resp_send(
      request,
      "{\"authenticated\":true}",
      HTTPD_RESP_USE_STRLEN
   );
}

// Handle GET /api/admin/clients and return the current client list as JSON
static esp_err_t admin_clients_get_handler(httpd_req_t *request)
{
   if (request == NULL) return ESP_ERR_INVALID_ARG;

   // Restrict the client registry to authenticated administrators
   if (!is_admin_http_request(request))
   {
      return httpd_resp_send_err(
         request,
         HTTPD_403_FORBIDDEN,
         "Administrator authorization required"
      );
   }

   // Refresh the new client registry before returning connected devices
   esp_err_t status = client_manager_sync_connected_clients();

   if (status != ESP_OK)
   {
      ESP_LOGE(
         LOG_TAG,
         "Client manager sync failed: %s",
         esp_err_to_name(status)
      );

      return httpd_resp_send_err(
         request,
         HTTPD_500_INTERNAL_SERVER_ERROR,
         "Unable to refresh connected clients"
      );
   }

   client_record_t clients[CLIENT_MANAGER_MAX_CLIENTS];
   size_t client_count = 0;

   // Retrieve the current clients from WiFi access point
   status = client_manager_get_clients(
      clients,
      CLIENT_MANAGER_MAX_CLIENTS,
      &client_count
   );

   if (status != ESP_OK)
   {
      ESP_LOGE(
         LOG_TAG,
         "Failed to retrieve connected clients: %s",
         esp_err_to_name(status)
      );

      return httpd_resp_send_err(
         request,
         HTTPD_500_INTERNAL_SERVER_ERROR,
         "Unable to retrieve connected clients"
      );
   }

   // Convert the client information into the dashboard API format
   cJSON *clients_json = create_clients_json(
      clients,
      client_count
   );

   if (clients_json == NULL) return ESP_ERR_NO_MEM;

   char *response = cJSON_PrintUnformatted(
      clients_json
   );

   cJSON_Delete(clients_json);

   if (response == NULL) return ESP_ERR_NO_MEM;

   httpd_resp_set_type(
      request,
      "application/json"
   );

   status = httpd_resp_send(
      request,
      response,
      HTTPD_RESP_USE_STRLEN
   );

   cJSON_free(response);

   return status;
}

// Receive and validate a complete WebSocket text message
static esp_err_t receive_websocket_text(
   httpd_req_t *request,
   httpd_ws_frame_t *frame,
   char *message,
   size_t buffer_size
)
{
   if (request == NULL || message == NULL || buffer_size < 2U || frame == NULL) return ESP_ERR_INVALID_ARG;

   // Reject fragmented, empty, oversized, or non-text messages
   if (frame->type != HTTPD_WS_TYPE_TEXT ||
      frame->fragmented || !frame->final) return ESP_ERR_NOT_SUPPORTED;

   if (frame->len == 0 || frame->len >= buffer_size) return ESP_ERR_INVALID_SIZE;

   size_t message_length = frame->len;
   frame->payload = (uint8_t *)message;

   esp_err_t status = httpd_ws_recv_frame(request, frame, message_length);
   if (status != ESP_OK) return status;

   message[message_length] = '\0';

   return ESP_OK;
}

// Handle terminal WebSocket connections from authorized controllers and admins
static esp_err_t terminal_websocket_handler(httpd_req_t *request)
{
   if (request == NULL) return ESP_ERR_INVALID_ARG;

   uint8_t client_mac[6];

   // Identify the requesting device using the existing client registry
   esp_err_t status = get_request_client_mac(request, client_mac);
   if (status != ESP_OK) return status;

   if (!client_manager_is_authorized(client_mac)) return ESP_ERR_INVALID_STATE;

   // Register authorized terminal clients and enforce five-connection limit
   if (request->method == HTTP_GET)
   {
      return terminal_session_manager_register(
         httpd_req_to_sockfd(request),
         client_mac
      );
   }

   httpd_ws_frame_t frame = {0};

   status = httpd_ws_recv_frame(request, &frame, 0);

   if (status != ESP_OK) return status;

   // Ignore other WebSocket control frames
   if (frame.type != HTTPD_WS_TYPE_TEXT) return ESP_OK;

   char message[513];

   status = receive_websocket_text(
      request,
      &frame,
      message,
      sizeof(message)
   );

   if (status != ESP_OK) return status;

   cJSON *root = cJSON_Parse(message);
   
   if (root == NULL)
   {
      // Report invalid JSON without terminating the WebSocket
      return send_websocket_response(
         httpd_req_to_sockfd(request),
         "terminal_result",
         ESP_ERR_INVALID_ARG
      );
   }

   // Dispatch the request and select its response event
   int socket_fd = httpd_req_to_sockfd(request);
   const char *event = "terminal_result";

   status = dispatch_terminal_action(
      request,
      root,
      &event
   );

   cJSON_Delete(root);

   // Ownership queries send their own response
   if (strcmp(event, "terminal_ownership_status_result") == 0) return status;

   // Return the execution result without closing the connection
   return send_websocket_response(
      socket_fd,
      event,
      status
   );
}

/*
   Handle WebSocket connections used by authenticated administrators.

   A WebSocket is added to the administrator registry only when its
   source device has already completed administrator authentication.
*/
static esp_err_t websocket_handler(httpd_req_t *request)
{
   if (request == NULL) return ESP_ERR_INVALID_ARG;

   if (request->method == HTTP_GET)
   {

      uint8_t client_mac[6];

      // Identify device opening the WebSocket connection
      esp_err_t status = get_request_client_mac(
         request,
         client_mac
      );

      if (status != ESP_OK)
      {
         ESP_LOGW(
            LOG_TAG,
            "Unable to identify WebSocket client: %s",
            esp_err_to_name(status)
         );

         return status;
      }

      // Only authenticated administrators may register an admin WebSocket.
      if (!client_manager_is_admin(client_mac))
      {
         ESP_LOGW(
            LOG_TAG,
            "Rejected WebSocket from unauthenticated client"
         );

         return ESP_ERR_INVALID_STATE;
      }

      int socket_fd = httpd_req_to_sockfd(request);

      status = register_admin_websocket(
         socket_fd,
         client_mac
      );

      if (status != ESP_OK)
      {
         ESP_LOGE(
            LOG_TAG,
            "Failed to register administrator WebSocket: %s",
            esp_err_to_name(status)
         );

         return status;
      }

      ESP_LOGI(
         LOG_TAG,
         "Administrator WebSocket connected: %02X:%02X:%02X:%02X:%02X:%02X",
         client_mac[0],
         client_mac[1],
         client_mac[2],
         client_mac[3],
         client_mac[4],
         client_mac[5]
      );

      return ESP_OK;
   }

   httpd_ws_frame_t frame = {0};

   // Read the frame header so control frames such as CLOSE can be handled.
   esp_err_t status = httpd_ws_recv_frame(
      request,
      &frame,
      0
   );

   if (status != ESP_OK)
   {
      ESP_LOGW(
         LOG_TAG,
         "Failed to receive WebSocket frame: %s",
         esp_err_to_name(status)
      );

      return status;
   }

   int socket_fd = httpd_req_to_sockfd(request);

   // Ignore control frames and unsupported message types
   if (frame.type != HTTPD_WS_TYPE_TEXT) return ESP_OK;

   char message[513];

   esp_err_t receive_status = receive_websocket_text(
      request,
      &frame,
      message,
      sizeof(message)
   );
   
   if (receive_status != ESP_OK) return receive_status;

   esp_err_t process_status = process_admin_websocket_message(
      socket_fd,
      message
   );

   if (process_status != ESP_OK)
   {
      ESP_LOGW(
         LOG_TAG,
         "Administrator WebSocket action failed: %s",
         esp_err_to_name(process_status)
      );
   }

   // Send the action result to admin who submitted
   esp_err_t response_status = send_admin_websocket_response(
      socket_fd,
      process_status
   );

   if (response_status != ESP_OK)
   {
      ESP_LOGW(
         LOG_TAG,
         "Failed to send administrator WebSocket response: %s",
         esp_err_to_name(response_status)
      );

      return response_status;
   }

   return ESP_OK;
}

// Release terminal ownership and connection slots when a socket closes
static void web_socket_close_callback(
   httpd_handle_t server,
   int socket_fd
)
{
   (void)server;

   // Record ownership before removing disconnected terminal connection
   bool disconnecting_device_is_owner = terminal_session_manager_is_owner(socket_fd);

   bool pending_requests_changed = 
      terminal_session_manager_unregister(socket_fd);

   // Notifiy remaining clients if the owning device's last connection closed
   if (disconnecting_device_is_owner && terminal_session_manager_get_owner() < 0)
      broadcast_terminal_ownership_changed();

   // Notify the current owner when a disconnect removes pending requests
   if (pending_requests_changed && terminal_session_manager_get_owner() >= 0)
      broadcast_terminal_pending_requests();

   // If the socket is non-admin this has no effect
   remove_admin_websocket(socket_fd);

   // Close the underlying socket after session cleanup
   close(socket_fd);
}

// Register one HTTP endpoint with the web server
static esp_err_t register_uri_handler(
   const char *uri,
   httpd_method_t method,
   esp_err_t (*handler)(httpd_req_t *request),
   bool is_websocket
)
{
   if (uri == NULL || handler == NULL)
      return ESP_ERR_INVALID_ARG;

   httpd_uri_t uri_config =
   {
      .uri = uri,
      .method = method,
      .handler = handler,
      .user_ctx = NULL,
      .is_websocket = is_websocket
   };

   return httpd_register_uri_handler(
      s_server,
      &uri_config
   );
}

// Register all HTTP endpoints handled by the web server
static esp_err_t register_uri_handlers(void)
{
   esp_err_t status = register_uri_handler(
      "/",
      HTTP_GET,
      frontend_index_get_handler,
      false
   );
   if (status != ESP_OK) return status;

   status = register_uri_handler(
      "/assets/app.js",
      HTTP_GET,
      frontend_js_get_handler,
      false
   );
   if (status != ESP_OK) return status;

   status = register_uri_handler(
      "/assets/app.css",
      HTTP_GET,
      frontend_css_get_handler,
      false
   );
   if (status != ESP_OK) return status;
   
   status = register_uri_handler(
      "/api/admin/login",
      HTTP_POST,
      admin_login_post_handler,
      false
   );
   if (status != ESP_OK) return status;

   status = register_uri_handler(
      "/api/admin/clients",
      HTTP_GET,
      admin_clients_get_handler,
      false
   );
   if (status != ESP_OK) return status;

   status = register_uri_handler(
      "/api/controller/request",
      HTTP_POST,
      controller_request_post_handler,
      false
   );
   if (status != ESP_OK) return status;

   status = register_uri_handler(
      "/api/controller/status",
      HTTP_GET,
      controller_status_get_handler,
      false
   );
   if (status != ESP_OK) return status;

   status = register_uri_handler(
      "/ws",
      HTTP_GET,
      websocket_handler,
      true
   );
   if (status != ESP_OK) return status;

   // Register the LED terminal WebSocket endpoint
   status = register_uri_handler(
      "/ws/terminal",
      HTTP_GET,
      terminal_websocket_handler,
      true
   );
   if (status != ESP_OK) return status;

   return ESP_OK;
}

// -----------------------------------------------------------
// ---------------- Public Function Definitions --------------
// -----------------------------------------------------------

esp_err_t web_server_start(void)
{
   if (s_initialized) return ESP_OK;
   initialize_admin_websockets();

   esp_err_t status = client_manager_init();

   if (status != ESP_OK)
   {
      ESP_LOGE(
         LOG_TAG,
         "Failed to initialize client manager: %s",
         esp_err_to_name(status)
      );

      return status;
   }

   // Initialize terminal connection and ownership tracking
   status = terminal_session_manager_init();
   if (status != ESP_OK) return status;

   httpd_config_t server_config = HTTPD_DEFAULT_CONFIG();

   // Allow additional endpoints for the LED terminal
   server_config.max_uri_handlers = 12;

   server_config.close_fn = web_socket_close_callback;

   status = httpd_start(
      &s_server,
      &server_config
   );

   if (status != ESP_OK) return status;

   // Register all HTTP endpoints after the server is created
   status = register_uri_handlers();

   if (status != ESP_OK)
   {
      httpd_stop(s_server);
      s_server = NULL;

      return status;
   }

   s_initialized = true;

   ESP_LOGI(
      LOG_TAG,
      "HTTP server started"
   );

   return ESP_OK;
}

/*
   Notify all administrator dashboards that the WiFi client list changed.

   Each active administrator WebSocket receives the event. WebSockets
   that can no longer be reached are removed from the registry.
*/
esp_err_t web_server_notify_clients_changed(void)
{
   if (!s_initialized)
      return ESP_OK;

   static const char message[] =
      "{\"event\":\"clients_changed\"}";

   httpd_ws_frame_t frame =
   {
      .final = true,
      .fragmented = false,
      .type = HTTPD_WS_TYPE_TEXT,
      .payload = (uint8_t *)message,
      .len = sizeof(message) - 1U
   };

   esp_err_t final_status = ESP_OK;

   for (size_t admin = 0; admin < WEB_MAX_CLIENTS; admin++)
   {
      int socket_fd = s_admin_websockets[admin].socket_fd;

      // Skip unused administrator WebSocket slots.
      if (socket_fd < 0)
         continue;

      // Remove WebSocket entries no longer recognized by the HTTP server
      if (!is_admin_websocket_connected(socket_fd))
      {
         remove_admin_websocket(socket_fd);
         continue;
      }

      esp_err_t status = httpd_ws_send_frame_async(
         s_server,
         socket_fd,
         &frame
      );

      if (status != ESP_OK)
      {
         ESP_LOGW(
            LOG_TAG,
            "Administrator WebSocket send failed: %s",
            esp_err_to_name(status)
         );

         remove_admin_websocket(socket_fd);
         final_status = status;
      }
   }

   return final_status;
}

esp_err_t web_server_stop(void)
{
   if (!s_initialized) return ESP_OK;

   esp_err_t status = httpd_stop(s_server);

   if (status != ESP_OK)
      return status;

   // Clear server and administrator connection state after shutdown.
   s_server = NULL;
   initialize_admin_websockets();
   s_initialized = false;

   ESP_LOGI(
      LOG_TAG,
      "HTTP server stopped"
   );

   return ESP_OK;
}